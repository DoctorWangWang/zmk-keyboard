## config/boards/shields/Y52/Kconfig.defconfig
```kconfig
# Copyright (c) 2020 Ryan Cross
# SPDX-License-Identifier: MIT

if SHIELD_Y52_LEFT

config ZMK_KEYBOARD_NAME
	default "y52"

config ZMK_SPLIT_ROLE_CENTRAL
	default y
	
endif



if SHIELD_Y52_LEFT || SHIELD_Y52_RIGHT

config ZMK_SPLIT
	default y

config BT_CTLR
	default BT

config ZMK_BLE
	default y

	

endif
```
